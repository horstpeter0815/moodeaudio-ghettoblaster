/dts-v1/;
/plugin/;

/ {
    compatible = "brcm,bcm2712";

    fragment@0 {
        target = <&i2c1>;
        __overlay__ {
            #address-cells = <1>;
            #size-cells = <0>;
            status = "okay";
            clock-frequency = <100000>;

            pcm5122: pcm5122@4d {
                #sound-dai-cells = <0>;
                compatible = "ti,pcm5122";
                reg = <0x4d>;
                clocks = <&audio>;
                AVDD-supply = <&vdd_3v3_reg>;
                DVDD-supply = <&vdd_3v3_reg>;
                CPVDD-supply = <&vdd_3v3_reg>;
            };
        };
    };

    fragment@1 {
        target = <&sound>;
        __overlay__ {
            compatible = "hifiberry,hifiberry-amp";
            i2s-controller = <&i2s>;
            status = "okay";
        };
    };
};
