/dts-v1/;

/ {
	compatible = "brcm,bcm2835";

	fragment@0 {
		target = <0xffffffff>;
		phandle = <0x06>;

		__overlay__ {
			#address-cells = <0x01>;
			#size-cells = <0x00>;
			status = "okay";

			port {

				endpoint {
					remote-endpoint = <0x01>;
					phandle = <0x02>;
				};
			};
		};
	};

	fragment@1 {
		target-path = "/";

		__overlay__ {
		};
	};

	fragment@2 {
		target = <0xffffffff>;
		phandle = <0x05>;

		__overlay__ {
			#address-cells = <0x01>;
			#size-cells = <0x00>;
			status = "okay";

			panel_disp1@45 {
				reg = <0x45>;
				compatible = "waveshare,10.1inch-panel";
				phandle = <0x03>;

				port {

					endpoint {
						remote-endpoint = <0x02>;
						phandle = <0x01>;
					};
				};
			};

			goodix@14 {
				reg = <0x14>;
				compatible = "goodix,gt911";
				phandle = <0x04>;
			};
		};
	};

	fragment@3 {
		target = <0xffffffff>;

		__overlay__ {
			status = "okay";
		};
	};

	fragment@4 {
		target = <0xffffffff>;

		__overlay__ {
			status = "okay";
		};
	};

	fragment@5 {
		target = <0xffffffff>;

		__dormant__ {
			status = "okay";
		};
	};

	__overrides__ {
		2_8_inch = [00 00 00 03 63 6f 6d 70 61 74 69 62 6c 65 3d 77 61 76 65 73 68 61 72 65 2c 32 2e 38 69 6e 63 68 2d 70 61 6e 65 6c 00 00 00 00 04 74 6f 75 63 68 73 63 72 65 65 6e 2d 73 69 7a 65 2d 78 3a 30 3d 34 38 30 00 00 00 00 04 74 6f 75 63 68 73 63 72 65 65 6e 2d 73 69 7a 65 2d 79 3a 30 3d 36 34 30 00 00 00 00 04 74 6f 75 63 68 73 63 72 65 65 6e 2d 69 6e 76 65 72 74 65 64 2d 79 3f 00 00 00 00 04 74 6f 75 63 68 73 63 72 65 65 6e 2d 73 77 61 70 70 65 64 2d 78 2d 79 3f 00];
		3_4_inch = [00 00 00 03 63 6f 6d 70 61 74 69 62 6c 65 3d 77 61 76 65 73 68 61 72 65 2c 33 2e 34 69 6e 63 68 2d 70 61 6e 65 6c 00 00 00 00 04 74 6f 75 63 68 73 63 72 65 65 6e 2d 73 69 7a 65 2d 78 3a 30 3d 38 30 30 00 00 00 00 04 74 6f 75 63 68 73 63 72 65 65 6e 2d 73 69 7a 65 2d 79 3a 30 3d 38 30 30 00];
		4_0_inch = [00 00 00 03 63 6f 6d 70 61 74 69 62 6c 65 3d 77 61 76 65 73 68 61 72 65 2c 34 2e 30 69 6e 63 68 2d 70 61 6e 65 6c 00 00 00 00 04 74 6f 75 63 68 73 63 72 65 65 6e 2d 73 69 7a 65 2d 78 3a 30 3d 38 30 30 00 00 00 00 04 74 6f 75 63 68 73 63 72 65 65 6e 2d 73 69 7a 65 2d 79 3a 30 3d 34 38 30 00 00 00 00 04 74 6f 75 63 68 73 63 72 65 65 6e 2d 69 6e 76 65 72 74 65 64 2d 78 3f 00 00 00 00 04 74 6f 75 63 68 73 63 72 65 65 6e 2d 73 77 61 70 70 65 64 2d 78 2d 79 3f 00];
		7_0_inchC = [00 00 00 03 63 6f 6d 70 61 74 69 62 6c 65 3d 77 61 76 65 73 68 61 72 65 2c 37 2e 30 69 6e 63 68 2d 63 2d 70 61 6e 65 6c 00 00 00 00 04 74 6f 75 63 68 73 63 72 65 65 6e 2d 73 69 7a 65 2d 78 3a 30 3d 38 30 30 00 00 00 00 04 74 6f 75 63 68 73 63 72 65 65 6e 2d 73 69 7a 65 2d 79 3a 30 3d 34 38 30 00];
		7_9_inch = <0x03 0x636f6d70 0x61746962 0x6c653d77 0x61766573 0x68617265 0x2c372e39 0x696e6368 0x2d70616e 0x656c0000 0x474 0x6f756368 0x73637265 0x656e2d73 0x697a652d 0x783a303d 0x34303936 0x00 0x4746f75 0x63687363 0x7265656e 0x2d73697a 0x652d793a 0x303d3430 0x39360000 0x474 0x6f756368 0x73637265 0x656e2d69 0x6e766572 0x7465642d 0x783f0000 0x474 0x6f756368 0x73637265 0x656e2d73 0x77617070 0x65642d78 0x2d793f00>;
		8_0_inch = [00 00 00 03 63 6f 6d 70 61 74 69 62 6c 65 3d 77 61 76 65 73 68 61 72 65 2c 38 2e 30 69 6e 63 68 2d 70 61 6e 65 6c 00 00 00 00 04 74 6f 75 63 68 73 63 72 65 65 6e 2d 73 69 7a 65 2d 78 3a 30 3d 38 30 30 00 00 00 00 04 74 6f 75 63 68 73 63 72 65 65 6e 2d 73 69 7a 65 2d 79 3a 30 3d 31 32 38 30 00 00 00 00 04 74 6f 75 63 68 73 63 72 65 65 6e 2d 69 6e 76 65 72 74 65 64 2d 78 3f 00 00 00 00 04 74 6f 75 63 68 73 63 72 65 65 6e 2d 73 77 61 70 70 65 64 2d 78 2d 79 3f 00];
		10_1_inch = <0x03 0x636f6d70 0x61746962 0x6c653d77 0x61766573 0x68617265 0x2c31302e 0x31696e63 0x682d7061 0x6e656c00 0x04 0x746f7563 0x68736372 0x65656e2d 0x73697a65 0x2d783a30 0x3d383030 0x00 0x4746f75 0x63687363 0x7265656e 0x2d73697a 0x652d793a 0x303d3132 0x38300000 0x474 0x6f756368 0x73637265 0x656e2d69 0x6e766572 0x7465642d 0x783f0000 0x474 0x6f756368 0x73637265 0x656e2d73 0x77617070 0x65642d78 0x2d793f00>;
		11_9_inch = [00 00 00 03 63 6f 6d 70 61 74 69 62 6c 65 3d 77 61 76 65 73 68 61 72 65 2c 31 31 2e 39 69 6e 63 68 2d 70 61 6e 65 6c 00 00 00 00 04 74 6f 75 63 68 73 63 72 65 65 6e 2d 69 6e 76 65 72 74 65 64 2d 78 3f 00 00 00 00 04 74 6f 75 63 68 73 63 72 65 65 6e 2d 73 77 61 70 70 65 64 2d 78 2d 79 3f 00];
		4_0_inchC = [00 00 00 03 63 6f 6d 70 61 74 69 62 6c 65 3d 77 61 76 65 73 68 61 72 65 2c 34 69 6e 63 68 2d 70 61 6e 65 6c 00 00 00 00 04 74 6f 75 63 68 73 63 72 65 65 6e 2d 73 69 7a 65 2d 78 3a 30 3d 37 32 30 00 00 00 00 04 74 6f 75 63 68 73 63 72 65 65 6e 2d 73 69 7a 65 2d 79 3a 30 3d 37 32 30 00];
		i2c1 = [00 00 00 05 74 61 72 67 65 74 3a 30 3d 00 ff ff ff ff 00 00 00 00 2d 33 2d 34 2b 35 00];
		disable_touch = <0x04 0x73746174 0x75733d64 0x69736162 0x6c656400>;
		rotation = [00 00 00 03 72 6f 74 61 74 69 6f 6e 3a 30 00];
		invx = <0x04 0x746f7563 0x68736372 0x65656e2d 0x696e7665 0x72746564 0x2d783f00>;
		invy = <0x04 0x746f7563 0x68736372 0x65656e2d 0x696e7665 0x72746564 0x2d793f00>;
		swapxy = [00 00 00 04 74 6f 75 63 68 73 63 72 65 65 6e 2d 73 77 61 70 70 65 64 2d 78 2d 79 3f 00];
		dsi0 = <0x06 0x74617267 0x65743a30 0x3d00ffff 0xffff0000 0x57461 0x72676574 0x3a303d00 0xffffffff>;
	};

	__symbols__ {
		dsi_frag = "/fragment@0";
		dsi_out = "/fragment@0/__overlay__/port/endpoint";
		i2c_frag = "/fragment@2";
		panel = "/fragment@2/__overlay__/panel_disp1@45";
		panel_in = "/fragment@2/__overlay__/panel_disp1@45/port/endpoint";
		touch = "/fragment@2/__overlay__/goodix@14";
	};

	__fixups__ {
		dsi1 = "/fragment@0:target:0";
		i2c_csi_dsi = "/fragment@2:target:0";
		i2c0if = "/fragment@3:target:0";
		i2c0mux = "/fragment@4:target:0";
		i2c_arm = "/fragment@5:target:0";
		i2c1 = "/__overrides__:i2c1:14";
		dsi0 = "/__overrides__:dsi0:14";
		i2c_csi_dsi0 = "/__overrides__:dsi0:32";
	};

	__local_fixups__ {

		fragment@0 {

			__overlay__ {

				port {

					endpoint {
						remote-endpoint = <0x00>;
					};
				};
			};
		};

		fragment@2 {

			__overlay__ {

				panel_disp1@45 {

					port {

						endpoint {
							remote-endpoint = <0x00>;
						};
					};
				};
			};
		};

		__overrides__ {
			2_8_inch = <0x00 0x27 0x44 0x61 0x7d>;
			3_4_inch = <0x00 0x27 0x44>;
			4_0_inch = <0x00 0x27 0x44 0x61 0x7d>;
			7_0_inchC = <0x00 0x29 0x46>;
			7_9_inch = <0x00 0x27 0x45 0x63 0x7f>;
			8_0_inch = <0x00 0x27 0x44 0x62 0x7e>;
			10_1_inch = <0x00 0x28 0x45 0x63 0x7f>;
			11_9_inch = <0x00 0x28 0x44>;
			4_0_inchC = <0x00 0x25 0x42>;
			i2c1 = <0x00>;
			disable_touch = <0x00>;
			rotation = <0x00>;
			invx = <0x00>;
			invy = <0x00>;
			swapxy = <0x00>;
			dsi0 = <0x00 0x12>;
		};
	};
};
